## drivers/net/Kconfig.dect_nrplus
```kconfig
if NET_L2_DECT_NRPLUS

config DECT_NRPLUS_RX_STACK_SIZE
	int "DECT NR+ L2 driver RX thread stack size"
	default 2048
	help
	  Stack size for the DECT NR+ L2 driver's RX thread. This thread
	  receives data from the CVG layer and passes it up to the IP stack.
	  
config DECT_NRPLUS_LOG_LEVEL
	int "DECT NR+ L2 driver log level"
	default 3
	range 0 4
	depends on NET_LOG
	help
	  Log level for the DECT NR+ L2 network driver.
	  0=off, 1=error, 2=warning, 3=info, 4=debug

endif # NET_L2_DECT_NRPLUS
```
