## lib/dect_nr_plus_NEW/Kconfig.dect_mac
```kconfig
# Kconfig for DECT NR+ MAC Layer

# Main menu for DECT MAC Layer configuration
menuconfig DECT_MAC_LAYER
	bool "DECT NR+ MAC Layer Support"
	default n
	help
	  Enable the DECT NR+ Medium Access Control (MAC) layer.
	  This layer is responsible for managing radio resources, device association,
	  data transmission scheduling, and basic link security as per ETSI TS 103 636-4.
	  It interacts with the nRF Modem DECT PHY library.

if DECT_MAC_LAYER

# General MAC Configuration
config DECT_MAC_ROLE_PT
	bool "MAC Role: Portable Termination (PT)"
	help
	  Configure this device to operate as a DECT NR+ Portable Termination.
	  A PT associates with a Fixed Termination (FT) to join a network.

config DECT_MAC_ROLE_FT
	bool "MAC Role: Fixed Termination (FT)"
	help
	  Configure this device to operate as a DECT NR+ Fixed Termination.
	  An FT forms a network and allows PTs to associate.

choice DECT_MAC_OPERATIONAL_ROLE
	prompt "DECT MAC Operational Role"
	default DECT_MAC_ROLE_NONE_SELECTED if !DECT_MAC_ROLE_PT && !DECT_MAC_ROLE_FT
	help
	  Select the primary operational role for this MAC instance.
	  Only one role can be primary at a time for a single MAC instance.
	  Ensure either PT or FT is selected if DECT_MAC_LAYER is enabled.

	config DECT_MAC_ROLE_IS_PT
		bool "Portable Termination (PT)"
		select DECT_MAC_ROLE_PT if !DECT_MAC_ROLE_FT

	config DECT_MAC_ROLE_IS_FT
		bool "Fixed Termination (FT)"
		select DECT_MAC_ROLE_FT if !DECT_MAC_ROLE_PT

	config DECT_MAC_ROLE_NONE_SELECTED
		bool "No DECT MAC Role Selected (Error)"
		# This option should ideally not be selectable if DECT_MAC_LAYER is y.
		# Add build error if DECT_MAC_LAYER is y and this is selected.
endchoice

config DECT_MAC_THREAD_STACK_SIZE
	int "MAC main processing thread stack size"
	default 4096 # Increased from previous example, assess actual needs
	help
	  Stack size for the main DECT MAC processing thread. This thread handles
	  events from the PHY and timers, and executes state machine logic.

config DECT_MAC_THREAD_PRIORITY
	int "MAC main processing thread priority"
	default 7 # Typical application thread priority
	help
	  Priority for the main DECT MAC processing thread.

config DECT_MAC_THREAD_SERVICE_INTERVAL_MS
	int "MAC thread periodic service interval (ms)"
	default 100
	help
	  Timeout for k_msgq_get in the MAC thread. Allows periodic servicing
	  of TX queues and scheduled operations even if no external events.
	  Shorter interval is more responsive but uses more CPU when idle.

config DECT_MAC_NETWORK_ID_MS24_PREFIX
	hex "Network ID - Most Significant 24 bits Prefix"
	default 0xDECC00
	help
	  The fixed 24-bit prefix for the DECT NR+ Network ID.
	  The least significant 8 bits are derived locally (e.g., from Long RD ID).
	  Ensure this prefix does not conflict with other networks.
	  Value 0x000000 is invalid per ETSI.

config DECT_MAC_PROVISIONED_LONG_RD_ID
	hex "Provisioned Long RD ID (32-bit)"
	default 0x0
	help
	  The pre-provisioned 32-bit Long Radio Device ID.
	  If set to 0 or 0xFFFFFFFF, the MAC core will attempt to derive one
	  from the hardware ID (e.g., using hw_id_get()).

config DECT_MAC_OWN_MU_CODE
    int "Own Default Mu (Subcarrier Scaling) Code (0-7)"
    default 0 # Code 0 => mu = 2^0 = 1 (27kHz for base)
    range 0 7 # Corresponds to mu values 1, 2, 4, 8, 16, 32, 64, 128 (though only 1,2,4,8 are typical for DECT NR+)
    help
      Code for this device's primary/default operational subcarrier scaling factor mu.
      Actual mu = 2^code. (Refer to ETSI TS 103 636-3 Annex B & Table 4.3-1).
      Typical DECT NR+ values for mu are 1, 2, 4, 8 (codes 0, 1, 2, 3).

config DECT_MAC_OWN_BETA_CODE
    int "Own Default Beta (FFT Scaling) Code (0-15)"
    default 0 # Code 0 => beta = 1 (code + 1)
    range 0 15 # Corresponds to beta values 1 to 16
    help
      Code for this device's primary/default FFT scaling factor beta.
      Actual beta = code + 1. (Refer to ETSI TS 103 636-3 Annex B & Table 4.3-1).


# MAC Security Configuration
config DECT_MAC_SECURITY_ENABLE
    bool "Enable MAC Layer Security (Mode 1)"
    default y # Usually desired for DECT NR+
    help
      Enable MAC layer security features as per ETSI TS 103 636-4, Mode 1
      (AES-128 CMAC for integrity, AES-128 CTR for ciphering).

if DECT_MAC_SECURITY_ENABLE

config DECT_MAC_MASTER_PSK_HEX
    string "Master Pre-Shared Key (32 hex chars for 16 bytes)"
    default "000102030405060708090A0B0C0D0E0F" 
    help
      The 16-byte master Pre-Shared Key (PSK) as a 32-character hexadecimal string.
      This key is used for the simplified PSK-based key derivation if no advanced
      authentication protocol is implemented.
      Example: "00112233445566778899AABBCCDDEEFF"
      IMPORTANT: For production, this key must be securely provisioned and
      this Kconfig option might be disabled or handled differently.

config DECT_MAC_HPC_RX_WINDOW_SIZE
    int "HPC Receive Window Size (Anti-Replay)"
    default 64
    range 16 256
    help
      Hyper Packet Counter (HPC) receive window size. Defines how many
      HPC values "behind" the newest known valid peer HPC are considered
      acceptable to accommodate packet reordering or minor desynchronization.
      A larger window is more tolerant but slightly increases replay risk if not combined
      with other measures. ETSI does not mandate a size.

config DECT_MAC_HPC_RX_FORWARD_WINDOW_MAX_ADVANCE
    int "HPC Receive Forward Window Maximum Advance"
    default 1024
    range 128 8192
    help
      Maximum allowable jump "ahead" for a received HPC value (in a MAC Sec Info IE)
      compared to the newest known valid peer HPC. Helps prevent accepting
      extremely large, potentially malicious or erroneous, HPC jumps which might
      invalidate a large portion of the valid HPC space.

config DECT_MAC_MAX_MIC_FAILURES_BEFORE_HPC_RESYNC
    int "Max MIC Failures Before Requesting HPC Resynchronization"
    default 3
    range 1 10
    help
      Number of consecutive Message Integrity Code (MIC) failures from a peer
      before this device requests an HPC resynchronization from that peer by
      sending a MAC Security Info IE with SecIVType HPC_RESYNC_INITIATE.

endif # DECT_MAC_SECURITY_ENABLE

# --- PT (Portable Termination) Specific Configuration ---
if DECT_MAC_ROLE_IS_PT || DECT_MAC_ROLE_PT # If PT is selected or enabled

config DECT_MAC_PT_KEEP_ALIVE_MS
	int "PT Keep-Alive Interval (ms)"
	default 20000 # 20 seconds
	help
	  Interval at which the PT sends a Keep-Alive message to the FT
	  when associated and idle, to maintain the association.

config DECT_MAC_PT_MOBILITY_ENABLE
    bool "Enable PT Mobility Scanning"
    default y
    help
      Enable the PT to periodically scan for alternative FTs for mobility purposes
      while associated with its current FT.

config DECT_MAC_PT_MOBILITY_SCAN_MS
	int "PT Mobility Scan Interval (ms)"
	default 60000 # 60 seconds
    depends on DECT_MAC_PT_MOBILITY_ENABLE
	help
	  Interval at which an associated PT performs a background scan for
	  other FTs for potential handover (mobility).

config DECT_MAC_PT_PAGING_CYCLE_MS
    int "PT Paging Cycle Listen Interval (ms)"
    default 1280 # Example: 1.28 seconds (ETSI DRF=8)
    help
      The interval at which the PT, when in paging mode, wakes up to listen
      for page messages from the FT. This value should ideally be
      negotiated or configured in conjunction with the FT.

config DECT_MAC_HARQ_PROCESSES_PT_TX_COUNT_CODE
    int "PT Requested HARQ TX Processes Code (0-7 for 1-8 processes)"
    default 3 # Code 3 = 4 processes (N = code + 1 if 0=1 process, or N=2^code)
              # ETSI 6.4.3.5: Num HARQ Proc: 0=1, 1=2, 2=4, 3=8. So this should map to 2 (for 4 processes).
              # Let's assume code 0->1, 1->2, 2->4, 3->8 for HARQ process count field.
              # If PT wants 4 TX procs, code is 2. If PT wants 8 TX procs, code is 3.
    range 0 3 # For 1, 2, 4, 8 processes respectively
    help
      Code for the number of HARQ TX processes the PT requests/supports.
      0=>1, 1=>2, 2=>4, 3=>8 processes.

config DECT_MAC_HARQ_MAX_RETX_DELAY_PT_CODE
    int "PT Max HARQ Re-TX Delay Code (0-31)"
    default 10 # Example code, maps to a specific ms value via ETSI table
    range 0 31
    help
      Code for the maximum HARQ re-transmission delay the PT can handle for its TX.

config DECT_MAC_HARQ_PROCESSES_PT_RX_COUNT_CODE
    int "PT Requested HARQ RX Processes Code (0-7 for 1-8 processes)"
    default 3 # Code 3 => 8 processes (as per ETSI RD Cap IE interpretation)
    range 0 3
    help
      Code for the number of HARQ RX processes the PT requests/supports.
      0=>1, 1=>2, 2=>4, 3=>8 processes.

config DECT_MAC_HARQ_MAX_RERX_DELAY_PT_CODE
    int "PT Max HARQ Re-RX Delay Code (0-31)"
    default 10 # Example code
    range 0 31
    help
      Code for the maximum HARQ re-transmission delay the PT expects for its RX.

config DECT_MAC_PT_DLC_SERVICE_SUPPORT_CODE
    int "PT DLC Service Type Support Code (0-7)"
    default 5 # Code 5 = Types 0,1,2,3 supported (ETSI TS 103 636-5 Annex B.1.2)
    help
      Code indicating which DLC service types this PT supports.
      Refer to ETSI TS 103 636-5 Annex B.1.2 for coding.

config DECT_MAC_PT_RX_TX_DIVERSITY_CODE
    int "PT RX for TX Diversity Antennas Code (0-3)"
    default 0 # Code 0 = 1 antenna (ETSI TS 103 636-3 Annex B.2)
    help
      Code for number of TX diversity antennas supported for reception.
      0=>1 ant, 1=>2 ant, 2=>4 ant, 3=>8 ant.

config DECT_MAC_PT_MU_CODE
    int "PT mu (Subcarrier Scaling Factor) Code (0-7)"
    default 0 # Code 0 => mu = 2^0 = 1 (ETSI TS 103 636-3 Annex B.2)
    help
      Code for PT's primary/preferred subcarrier scaling factor mu. mu = 2^code.

config DECT_MAC_PT_BETA_CODE
    int "PT beta (FFT Scaling Factor) Code (0-15)"
    default 0 # Code 0 => beta = 1 (code + 1) (ETSI TS 103 636-3 Annex B.2)
    help
      Code for PT's primary/preferred FFT scaling factor beta. beta = code + 1.

config DECT_MAC_PT_MAX_NSS_RX_CODE
    int "PT Max RX Spatial Streams Code (0-3)"
    default 0 # Code 0 => 1 stream (ETSI TS 103 636-3 Annex B.2)
    help
      Code for maximum number of spatial streams PT can receive.
      0=>1, 1=>2, 2=>4, 3=>8 streams.

config DECT_MAC_PT_MAX_MCS_CODE
    int "PT Max Supported MCS Index Code (0-11)"
    default 11 # Code 11 => MCS11 (ETSI TS 103 636-3 Annex B.2)
    help
      Code for highest MCS index PT supports for reception.

config DECT_MAC_PT_HARQ_BUFFER_CODE
    int "PT HARQ Soft Buffer Size Code (0-15)"
    default 7 # Example: Code 7 might map to 1024000 bytes (ETSI TS 103 636-3 Annex B.2)
    help
      Code representing PT's HARQ soft buffer size. Refer to ETSI for mapping.

config DECT_MAC_PT_NUM_HARQ_PROC_CODE # Note: This is same as HARQ_PROCESSES_PT_RX_COUNT_CODE essentially for RD Cap
    int "PT Number of HARQ Processes Support Code (0-3)"
    default 3 # Code 3 => 8 processes
    help
      Code for number of parallel HARQ processes PT supports. 0=>1, 1=>2, 2=>4, 3=>8.

config DECT_MAC_PT_HARQ_FEEDBACK_DELAY_CODE
    int "PT HARQ Feedback Delay Code (0-15)"
    default 0 # Code 0 => 2 subslots (ETSI TS 103 636-3 Annex B.2)
    help
      Code for PT's HARQ feedback processing delay.

config DECT_MAC_PT_SUPPORTS_DECT_DELAY
    bool "PT Supports DECT_Delay for RACH response"
    default n # Example
    help
      PT indicates if it supports the DECT_Delay mechanism for RACH response timing.

config DECT_MAC_PT_SUPPORTS_HALF_DUPLEX
    bool "PT Supports Half-Duplex operation for RACH/DL"
    default n # Example
    help
      PT indicates if it supports receiving RACH response or scheduled DL on a different
      channel than its RACH UL transmission.

config DECT_MAC_PT_SUPPORTS_GROUP_ASSIGNMENT
    bool "PT Supports Group Assignment"
    default n

config DECT_MAC_PT_SUPPORTS_PAGING
    bool "PT Supports Paging"
    default y

config DECT_MAC_PT_SUPPORTS_MESH
    bool "PT Supports Mesh Operation"
    default n

endif # DECT_MAC_ROLE_IS_PT

# --- FT (Fixed Termination) Specific Configuration ---
if DECT_MAC_ROLE_IS_FT || DECT_MAC_ROLE_FT # If FT is selected or enabled

config DECT_MAC_FT_CLUSTER_BEACON_MS
	int "FT Cluster Beacon Interval (ms)"
	default 100 # 100 ms is a common value
	help
	  Interval at which the FT transmits its Cluster Beacon.
	  Must be one of the ETSI defined values (10, 50, 100, 500, 1000, 1500, 2000, 4000, 8000, 16000, 32000 ms).

config DECT_MAC_FT_NETWORK_BEACON_MS
	int "FT Network Beacon Interval (ms)"
	default 1000 # Example: 1 second
	help
	  Interval at which the FT transmits its Network Beacon (if distinct from Cluster Beacon).
	  Must be one of the ETSI defined values (50, 100, 500, 1000, 1500, 2000, 4000 ms).
      Currently, this driver sends a combined Cluster/Network Beacon. This interval is for the
      network beacon information part that points to the cluster beacon.

config DECT_MAC_FT_MAX_ASSOCIATED_PTS
    int "FT Maximum number of associated PTs"
    default 8 # Matches MAX_PEERS_PER_FT in context
    range 1 255 # Practical limits are lower
    help
      Maximum number of Portable Terminations that this Fixed Termination
      can simultaneously have associated.

config DECT_MAC_FT_SECURE_ON_ASSOC
    bool "FT Policy: Require Secure Association"
    default y
    help
      If enabled, the FT will attempt to establish a secure link (using derived
      keys from Master PSK) immediately upon successful association response.
      If disabled, the link will initially be unsecure, requiring a separate
      authentication procedure to secure it.

config DECT_MAC_FT_DEFAULT_OPERATING_CARRIER_KHZ
    int "FT Default Initial Operating Carrier (kHz)"
    default 1924992 # Example US DECT 6.0 Ch2: 1924.992 MHz
    help
      The default carrier frequency (in kHz) the FT will attempt to use or
      scan first if DCS is not able to select one. Ensure this is a valid
      channel number in your regulatory domain.
      E.g., ETSI: 1881792 + k*1728. US: 1921536 + k*1728.

config DECT_MAC_DCS_NUM_CHANNELS_TO_SCAN
    int "Number of channels for FT to scan during DCS"
    default 3
    range 0 10 # Example range, max depends on band
    help
      Number of candidate channels the FT will scan during Dynamic Channel
      Selection. If 0, DCS is skipped. Channel list itself is currently
      hardcoded/simple in SM, TODO: make configurable.

config DECT_MAC_DCS_CHANNEL_LIST
    string "DCS Candidate Channel List (comma-separated kHz)"
    default "1881792,1883520,1885248,1886976,1888704" # Example ETSI DECT EU Ch 0-4
    depends on DECT_MAC_DCS_NUM_CHANNELS_TO_SCAN > 0
    help
      Comma-separated list of absolute carrier frequencies in kHz for the FT
      to consider during Dynamic Channel Selection. The number of channels actually
      scanned is limited by DECT_MAC_DCS_NUM_CHANNELS_TO_SCAN.
      Ensure these are valid channels for your regulatory domain and hardware band.
      Example ETSI Band 1 (1880-1900MHz): 1881792 + k * 1728 (for k=0..9)
      Example US DECT 6.0 (1920-1930MHz): 1921536 + k * 1728 (for k=0..4)

config DECT_MAC_DCS_NOISY_THRESHOLD_DBM
    int "DCS Noisy Channel Threshold (dBm)"
    default -70 # Example: channels noisier than -70dBm might be less preferred
    help
      Average RSSI threshold (in dBm, e.g., -70) above which a channel scanned
      during DCS is considered "too noisy" and might be deprioritized or avoided,
      even if it's below the absolute 'busy' threshold used for LBT.

config DECT_MAC_FT_COUNT_TO_TRIGGER_CODE
    int "FT Beacon: Count To Trigger Code (0-7)"
    default 7 # Code 7 = 256 times (ETSI Table 6.4.2.3-1)
    range 0 7
    help
      Code for Count_To_Trigger field in Cluster Beacon IE.
      Determines how many times a PT must measure a better FT before handover.

config DECT_MAC_FT_REL_QUALITY_CODE
    int "FT Beacon: Relative Quality Code (0-7)"
    default 2 # Code 2 = 6 dB (ETSI Table 6.4.2.3-1)
    range 0 7
    help
      Code for Rel_Quality field in Cluster Beacon IE.
      Relative RSSI difference for PT mobility decisions.

config DECT_MAC_FT_MIN_QUALITY_CODE
    int "FT Beacon: Minimum Quality Code (0-3)"
    default 1 # Code 1 = 3 dB above sensitivity (ETSI Table 6.4.2.3-1)
    range 0 3
    help
      Code for Min_Quality field in Cluster Beacon IE.
      Minimum quality for PT to consider associating.

config DECT_MAC_DCS_ACCEPTABLE_BUSY_PERCENT
    int "DCS Acceptable Channel Busy Percentage"
    default 20 # Channels busier than this are heavily penalized or avoided
    range 0 100
    help
      Maximum percentage of RSSI samples that can be above the 'busy' threshold
      (rssi_threshold_max_dbm) for a channel to be considered a good candidate
      during Dynamic Channel Selection by the FT.

config DECT_MAC_FT_USE_FRAME_OFFSET
    bool "FT Beacon: Enable Frame Offset field"
    default n
    help
      If enabled, the FT will include the Frame Offset field in its
      Cluster Beacon IE. The actual offset value needs to be configured
      or managed by the FT (e.g. ctx->role_ctx.ft.current_frame_offset_subslots).
      The field width (8 or 16 bits) depends on FT's mu.

config DECT_MAC_FT_DEFAULT_SCHEDULE_REPEAT_FRAMES
    int "FT Default Schedule: Repetition Interval (Frames)"
    default 10
    help
      Default repetition interval in frames for initial schedules assigned to PTs.
      (Corresponds to Repetition field in Resource Allocation IE if repeat_type is frames).

config DECT_MAC_FT_DEFAULT_SCHEDULE_VALIDITY_FRAMES
    int "FT Default Schedule: Validity Duration (Frames)"
    default 100
    help
      Default validity duration in frames for initial schedules assigned to PTs.
      (0xFF for permanent).

config DECT_MAC_FT_SCHEDULE_START_SFN_OFFSET
    int "FT Default Schedule: Start SFN Offset from current SFN"
    default 2
    help
      Offset from the FT's current SFN for the SFN_val field in the initial
      Resource Allocation IE sent to a newly associated PT. (e.g., 2 means SFN_current + 2).

endif # DECT_MAC_ROLE_IS_FT

# MAC General Parameters (apply to both roles or are general config)
config DECT_MAC_RSSI_THR_MIN_DBM
    int "RSSI Threshold Min for 'free' channel (dBm)"
    default -90 # Example value, ETSI specifies defaults based on band
    help
      RSSI-1 threshold below which a subslot is considered 'free' by the MAC.
      (Relates to ETSI RSSI_THRESHOLD_MIN)

config DECT_MAC_RSSI_THR_MAX_DBM
    int "RSSI Threshold Max for 'busy' channel (dBm)"
    default -75 # Example value, ETSI specifies defaults based on band
    help
      RSSI-1 threshold above which a subslot is considered 'busy' by the MAC.
      Between MIN and MAX is 'possible'. (Relates to ETSI RSSI_THRESHOLD_MAX)

config DECT_MAC_RACH_CW_MIN_IDX
    int "RACH Contention Window Min Index (0-7)"
    default 2 # CW_MIN = 8 * (2^index) => 8*4=32 for index 2
    range 0 7
    help
      Index for calculating initial RACH Contention Window (CW_MIN).
      CW_MIN = 8 * (2^value). ETSI 5.3.1.

config DECT_MAC_RACH_CW_MAX_IDX
    int "RACH Contention Window Max Index (0-7)"
    default 6 # CW_MAX = 8 * (2^index) => 8*64=512 for index 6
    range 0 7
    help
      Index for calculating maximum RACH Contention Window (CW_MAX).
      CW_MAX = 8 * (2^value). ETSI 5.3.1.

config DECT_MAC_RACH_RESP_WIN_MS
    int "RACH Response Window Timeout (ms)"
    default 200 # Default timeout for PT to wait for Association Response.
                # Should be derived from FT's RACH Info IE in beacon.
    help
      Timeout for a PT waiting for a response after sending a RACH message
      (e.g., Association Request). The FT's beacon should advertise its
      actual response window. This is a PT-side fallback/max.

config DECT_MAC_DEFAULT_DATA_MCS
    int "Default MCS code for data transmissions"
    default 0 # MCS0 (robust)
    range 0 11 # Valid MCS indices
    help
      Default Modulation and Coding Scheme index to be used for data PDUs
      if no other link adaptation mechanism is active or has selected an MCS.

# Log Levels for MAC submodules
config DECT_MAC_API_LOG_LEVEL
    int "Log level for DECT MAC API module"
    default 3 # Info
    range 0 4
    depends on LOG

config DECT_MAC_CORE_LOG_LEVEL
    int "Log level for DECT MAC Core module"
    default 3 # Info
    range 0 4
    depends on LOG

config DECT_MAC_DATA_PATH_LOG_LEVEL
    int "Log level for DECT MAC Data Path module"
    default 3 # Info
    range 0 4
    depends on LOG

config DECT_MAC_DISPATCHER_LOG_LEVEL
    int "Log level for DECT MAC Dispatcher module"
    default 3 # Info
    range 0 4
    depends on LOG

config DECT_MAC_MGMT_LOG_LEVEL
    int "Log level for DECT MAC Management service module"
    default 3 # Info
    range 0 4
    depends on LOG

config DECT_MAC_PDU_LOG_LEVEL
    int "Log level for DECT MAC PDU module"
    default 3 # Info
    range 0 4
    depends on LOG

config DECT_MAC_PHY_CTRL_LOG_LEVEL
    int "Log level for DECT MAC PHY Control module"
    default 3 # Info
    range 0 4
    depends on LOG

config DECT_MAC_PHY_IF_LOG_LEVEL
    int "Log level for DECT MAC PHY Interface module"
    default 3 # Info
    range 0 4
    depends on LOG

config DECT_MAC_SECURITY_LOG_LEVEL
    int "Log level for DECT MAC Security module"
    default 3 # Info
    range 0 4
    depends on LOG

config DECT_MAC_SM_FT_LOG_LEVEL
    int "Log level for DECT MAC FT State Machine module"
    default 3 # Info
    range 0 4
    depends on LOG

config DECT_MAC_SM_PT_LOG_LEVEL
    int "Log level for DECT MAC PT State Machine module"
    default 3 # Info
    range 0 4
    depends on LOG

config DECT_MAC_SHELL_ENABLE
    bool "Enable DECT MAC Debug Shell Commands"
    default y if SHELL
    depends on SHELL
    help
      Enable a set of shell commands for debugging and testing the DECT MAC layer.

config DECT_MAC_SHELL_LOG_LEVEL
    int "Log level for DECT MAC Shell module"
    default 3 # Info
    range 0 4
    depends on LOG && DECT_MAC_SHELL_ENABLE


# Max size of data[] array in mac_sdu_t (holds a DLC PDU)
config DECT_MAC_SDU_MAX_SIZE
    int "Maximum MAC SDU (DLC PDU) payload size"
    default 1636 # Max ETSI DLC SDU, or MAC SDU Area before MUX headers
    help
      Defines the size of the data buffer within the mac_sdu_t structure.
      This buffer is used to carry a DLC PDU (which is a MAC SDU from MAC's perspective)
      or the content of the MAC SDU Area after MAC common headers.
      ETSI TS 103 636-5 specifies max DLC SDU size, but the MAC PDU can also
      carry MUXed IEs. This should be large enough for the largest expected content
      that goes into the MAC SDU Area (after common headers, before MIC).
      The maximum PDSCH TBS for µ=1,β=1,MCS0,j=16 is 2120 bits (265 bytes).
      The MAC PDU can be up to ~1638 bytes as per some interpretations for PDC.
      Let's align with ETSI 103 636-4, 6.3.1: "The basic MAC PDU structure..."
      The MAC SDU (DLC PDU) part itself can be large.
      This needs to be consistent with CONFIG_DECT_DLC_MAX_SDU_PAYLOAD_SIZE if CVG->DLC->MAC.

config DECT_MAC_PDU_MAX_SIZE
    int "Maximum total MAC PDU size for PHY"
    default 1638 # Example, from PDSCH TBS for higher MCS/longer duration
                 # This should be the largest size the PHY can transmit in one go.
                 # For ETSI Part 3, Annex C, C.4 (Quad Slot), MCS11 with Nss=1 for beta=8, TBS is 2.212.888 bits (276KB) - this is wrong.
                 # Let's look at Table C.2-1 (single slot): MCS11 max is 6048 bits (756 bytes).
                 # If we take a very large value from ETSI Annex C, e.g. max for quad slot (4*Tslot)
                 # Table C.4-1 for quad slot, Nss=1, mu=1, beta=16, MCS11 is 264800 bits = 33100 bytes (this seems too large for typical use)
                 # A more reasonable interpretation is related to Z=2048 for code block size.
                 # Max payload for nRF modem seems to be around 1600-2000 bytes for some PHYs.
                 # ETSI MAC (Part 4) doesn't explicitly limit total MAC PDU size other than through PHY frame structure.
                 # The nRF modem DECT PHY API or product spec should define max data_size for nrf_modem_dect_phy_tx.
                 # Defaulting to a reasonable large value for now.
    help
      Maximum size of the entire MAC PDU (MAC Hdr Type + Common Hdr + SDU Area + MIC)
      that can be constructed and passed to the PHY for transmission.
      This affects buffer sizing for PDU construction.

endif # DECT_MAC_LAYER
```
